## boards/arm/pyble_nrf52840/Kconfig
```kconfig
config BOARD_PYBLE_NRF52840
    bool "pyBLE-NRF52840 board"
    depends on SOC_NRF52840_QIAA
```

## boards/arm/pyble_nrf52840/Kconfig.board
```kconfig
choice
    prompt "Board Selection"

config BOARD_PYBLE_NRF52840
    bool "pyBLE NRF52840"
    depends on SOC_NRF52840_QIAA

endchoice
```

## boards/arm/pyble_nrf52840/Kconfig.defconfig
```kconfig
if BOARD_PYBLE_NRF52840

config BOARD
    default "pyble_nrf52840"

config BT_HCI_H4
    bool
    default n

config BT_CTLR
    bool
    default y

config IEEE802154_NRF5
    bool
    default y

endif
```

## boards/arm/pyble_nrf52840/pyble_nrf52840_defconfig
```kconfig
# Core SOC and Hardware
CONFIG_SOC_NRF52840_QIAA=y
CONFIG_SOC_SERIES_NRF52X=y
CONFIG_GPIO=y

# Bluetooth and ZMK Essentials
CONFIG_BT=y
CONFIG_BT_PERIPHERAL=y
CONFIG_BT_CTLR=y
CONFIG_ZMK_BLE=y

# USB Configuration
CONFIG_USB_DEVICE_STACK=y
CONFIG_USB_DEVICE_DRIVER=y
CONFIG_USB_NRFX=y
CONFIG_ZMK_USB=y
CONFIG_USB_DEVICE_PRODUCT="ZMK Keyboard"

# Disable Logging and Console 
CONFIG_SERIAL=n
CONFIG_CONSOLE=n
CONFIG_UART_CONSOLE=n
CONFIG_LOG=n
CONFIG_ZMK_USB_LOGGING=n

# Bootloader compatibility
CONFIG_BOOTLOADER_MCUBOOT=n
```

## config/Kconfig.defconfig
```kconfig
if ZMK_KEYBOARD_HT20061996

config ZMK_KEYBOARD_NAME
    default "ht20061996"

endif
```

## config/shield/ht20061996/Kconfig.shield
```kconfig
config ZMK_KEYBOARD_HT20061996
    bool "HT20061996 Keyboard"
    depends on SHIELD_HT20061996
    select ZMK_KEYBOARD
```
