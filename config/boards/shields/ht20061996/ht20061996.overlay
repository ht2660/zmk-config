#include "ht20061996-layouts.dtsi"

/ {
    chosen {
        zmk,keyboard = &ht20061996;
        zmk,matrix-transform = &matrix_transform;
    };

    ht20061996: keyboard {
        compatible = "zmk,keyboard-matrix";
        label = "HT20061996";

        rows = <5>;
        columns = <14>;

        row-gpios = <
            &gpio0 6 (GPIO_ACTIVE_LOW | GPIO_PULL_UP)
            &gpio0 8 (GPIO_ACTIVE_LOW | GPIO_PULL_UP)
            &gpio0 17 (GPIO_ACTIVE_LOW | GPIO_PULL_UP)
            &gpio0 20 (GPIO_ACTIVE_LOW | GPIO_PULL_UP)
            &gpio0 22 (GPIO_ACTIVE_LOW | GPIO_PULL_UP)
        >;

        col-gpios = <
            &gpio1 0 (GPIO_ACTIVE_LOW | GPIO_PULL_UP)
            &gpio1 1 (GPIO_ACTIVE_LOW | GPIO_PULL_UP)
            &gpio1 2 (GPIO_ACTIVE_LOW | GPIO_PULL_UP)
            &gpio1 3 (GPIO_ACTIVE_LOW | GPIO_PULL_UP)
            &gpio1 4 (GPIO_ACTIVE_LOW | GPIO_PULL_UP)
            &gpio1 5 (GPIO_ACTIVE_LOW | GPIO_PULL_UP)
            &gpio1 6 (GPIO_ACTIVE_LOW | GPIO_PULL_UP)
            &gpio1 7 (GPIO_ACTIVE_LOW | GPIO_PULL_UP)
            &gpio1 8 (GPIO_ACTIVE_LOW | GPIO_PULL_UP)
            &gpio1 9 (GPIO_ACTIVE_LOW | GPIO_PULL_UP)
            &gpio1 10 (GPIO_ACTIVE_LOW | GPIO_PULL_UP)
            &gpio1 11 (GPIO_ACTIVE_LOW | GPIO_PULL_UP)
            &gpio1 12 (GPIO_ACTIVE_LOW | GPIO_PULL_UP)
            &gpio1 13 (GPIO_ACTIVE_LOW | GPIO_PULL_UP)
        >;
    };
};
/ {
    matrix_transform: matrix_transform {
        compatible = "zmk,matrix-transform";
        rows = <5>;
        columns = <14>;

        map = <
             0  1  2  3  4  5  6  7  8  9 10 11 12 13
           14 15 16 17 18 19 20 21 22 23 24 25 26 27
           28 29 30 31 32 33 34 35 36 37 38 39 40 
           41 42 43 44 45 46 47 48 49 50 51 52 53 54
           55 56 57 58 59 60 61 62 63
        >;
    };
};